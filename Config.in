## Config.in
```kconfig
source "$BR2_EXTERNAL_FHEM_CCU2_PATH/package/fhem/Config.in"
source "$BR2_EXTERNAL_FHEM_CCU2_PATH/package/fhem-hmrpc/Config.in"

menu "PERL Module"
source "$BR2_EXTERNAL_FHEM_CCU2_PATH/package/perl-device-serialport/Config.in"
source "$BR2_EXTERNAL_FHEM_CCU2_PATH/package/perl-json/Config.in"
source "$BR2_EXTERNAL_FHEM_CCU2_PATH/package/perl-dbi/Config.in"
source "$BR2_EXTERNAL_FHEM_CCU2_PATH/package/perl-dbd-sqlite/Config.in"
source "$BR2_EXTERNAL_FHEM_CCU2_PATH/package/perl-rpc-xml/Config.in"
source "$BR2_EXTERNAL_FHEM_CCU2_PATH/package/perl-xml-parser/Config.in"
endmenu
```

## configs/ccu2_defconfig
```kconfig
BR2_arm=y
BR2_DL_DIR="$(BR2_EXTERNAL_FHEM_CCU2_PATH)/downloads"
BR2_BACKUP_SITE="http://sources.buildroot.net/"
BR2_KERNEL_MIRROR="http://www.kernel.org/pub/"
BR2_CCACHE=y
BR2_STRIP_none=y
BR2_PACKAGE_OVERRIDE_FILE="$(TOPDIR)/local.mk"
BR2_TOOLCHAIN_EXTERNAL=y
BR2_TARGET_OPTIMIZATION="-pipe"
BR2_TARGET_GENERIC_HOSTNAME="fhem-ccu2"
BR2_TARGET_GENERIC_ISSUE="Welcome to FHEM-CCU2"
BR2_ROOTFS_DEVICE_CREATION_DYNAMIC_MDEV=y
BR2_ROOTFS_DEVICE_TABLE=""
BR2_TARGET_GENERIC_ROOT_PASSWD="root"
BR2_TARGET_GENERIC_GETTY_PORT="ttyAMA0"
BR2_TARGET_GENERIC_GETTY_BAUDRATE_115200=y
BR2_SYSTEM_DHCP="eth0"
BR2_TARGET_TZ_INFO=y
BR2_TARGET_LOCALTIME="Europe/Berlin"
BR2_ROOTFS_OVERLAY="$(BR2_EXTERNAL_FHEM_CCU2_PATH)/board/ccu2/overlay"
BR2_ROOTFS_POST_IMAGE_SCRIPT="$(BR2_EXTERNAL_FHEM_CCU2_PATH)/board/ccu2/make_update.sh"
BR2_LINUX_KERNEL=y
BR2_LINUX_KERNEL_CUSTOM_VERSION=y
BR2_LINUX_KERNEL_CUSTOM_VERSION_VALUE="3.4.11"
BR2_LINUX_KERNEL_PATCH="$(BR2_EXTERNAL_FHEM_CCU2_PATH)/board/ccu2/kernel_*.patch"
BR2_LINUX_KERNEL_USE_CUSTOM_CONFIG=y
BR2_LINUX_KERNEL_CUSTOM_CONFIG_FILE="$(BR2_EXTERNAL_FHEM_CCU2_PATH)/board/ccu2/linux_defconfig"
BR2_LINUX_KERNEL_UIMAGE=y
BR2_PACKAGE_BUSYBOX_CONFIG="$(BR2_EXTERNAL_FHEM_CCU2_PATH)/board/ccu2/busybox.config"
BR2_PACKAGE_BUSYBOX_SHOW_OTHERS=y
BR2_PACKAGE_BUSYBOX_WATCHDOG=y
BR2_PACKAGE_STRACE=y
BR2_PACKAGE_LIBTOOL=y
BR2_PACKAGE_MTD=y
BR2_PACKAGE_TRIGGERHAPPY=y
BR2_PACKAGE_OPENSSL=y
BR2_PACKAGE_SQLITE=y
BR2_PACKAGE_DHCPCD=y
BR2_PACKAGE_DROPBEAR=y
BR2_PACKAGE_IFPLUGD=y
BR2_PACKAGE_IPUTILS=y
BR2_PACKAGE_WGET=y
BR2_PACKAGE_DCRON=y
# BR2_TARGET_ROOTFS_TAR is not set
BR2_TARGET_ROOTFS_UBIFS=y
BR2_TARGET_ROOTFS_UBIFS_LEBSIZE=0x1F000
BR2_TARGET_ROOTFS_UBIFS_MINIOSIZE=0x0800
BR2_TARGET_ROOTFS_UBIFS_MAXLEBCNT=384
BR2_TARGET_ROOTFS_UBI=y
BR2_TARGET_ROOTFS_UBI_SUBSIZE=0
BR2_TARGET_ROOTFS_UBI_USE_CUSTOM_CONFIG=y
BR2_TARGET_ROOTFS_UBI_CUSTOM_CONFIG_FILE="$(BR2_EXTERNAL_FHEM_CCU2_PATH)/board/ccu2/ubinize.cfg"
BR2_TARGET_BAREBOX=y
BR2_TARGET_BAREBOX_CUSTOM_TARBALL=y
BR2_TARGET_BAREBOX_CUSTOM_TARBALL_LOCATION="https://github.com/eq-3/occu/raw/master/CCU2/download/barebox-2012.02.0-eQ-3.tar.gz"
BR2_TARGET_BAREBOX_BOARD_DEFCONFIG="eq3_ccu2"
BR2_TARGET_BAREBOX_BAREBOXENV=y
BR2_PACKAGE_FHEM=y
```

## package/fhem-hmrpc/Config.in
```kconfig
config BR2_PACKAGE_FHEM_HMRPC
        bool "fhem-hmrpc"
	depends on BR2_PACKAGE_FHEM
	select BR2_PACKAGE_PERL_XML_PARSER
	select BR2_PACKAGE_PERL_RPC_XML 
        help
		Module to access the Homematic XML-RPC API of a CCU with FHEM
		
		https://github.com/henryk/fhem-HMRPC
```

## package/fhem/Config.in
```kconfig
config BR2_PACKAGE_FHEM
        bool "fhem"
	select BR2_PACKAGE_PERL_DBD_SQLITE
	select BR2_PACKAGE_PERL
	select BR2_PACKAGE_PERL_DBI
	select BR2_PACKAGE_PERL_JSON
	select BR2_PACKAGE_PERL_DEVICE_SERIALPORT
        select BR2_PACKAGE_PERL_XML_PARSER
        select BR2_PACKAGE_PERL_RPC_XML
	select BR2_PACKAGE_TCL
	select BR2_PACKAGE_PERL_IO_SOCKET_SSL
	select BR2_PACKAGE_CA_CERTIFICATES
        help
		FHEM (TM) is a GPL'd perl server for house automation. 
		It is used to automate some common tasks in the household like switching lamps / shutters / heating / etc. 
		and to log events like temperature / humidity / power consumption.
```

## package/perl-json/Config.in
```kconfig
config BR2_PACKAGE_PERL_JSON
        bool "perl-json"
	select BR2_PACKAGE_PERL
        help
		JSON - JSON (JavaScript Object Notation) encoder/decoder
		https://metacpan.org/pod/JSON
```

## package/perl-rpc-xml/Config.in
```kconfig
config BR2_PACKAGE_PERL_RPC_XML
	bool "perl-rpc-xml"
	depends on !BR2_STATIC_LIBS
	select BR2_PACKAGE_PERL_XML_PARSER
	select BR2_PACKAGE_PERL_LIBWWW_PERL
	help
	  Data, client and server classes for XML-RPC

	  http://search.cpan.org/dist/RPC-XML

comment "perl-rpc-xml needs a toolchain w/ dynamic library"
	depends on BR2_STATIC_LIBS
```

## package/perl-sys-statistics-linux/Config.in
```kconfig
config BR2_PACKAGE_PERL_SYS_STATISTICS_LINUX
	bool "perl-sys-statistics-linux"
	help
	  Front-end module to collect system statistics

	  https://metacpan.org/release/Sys-Statistics-Linux
```
